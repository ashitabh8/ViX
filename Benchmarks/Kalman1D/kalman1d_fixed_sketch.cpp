//[ARD:REMOVE_BEGIN]
#include "../../include/distributions_latest.hpp"
#include "../../include/ios.hpp"
#include <iostream>
#include <fstream>
#include <random>
//[ARD:REMOVE_END]

//[ARD:UNDEFS]

//[ARD:ADD_HEADER]

// 14 fractional bits + 2^5 scaling factor gives good results.

// #define T double
#define T [PY:TYPE]
#define SIGMA_LB 0.1
#define SIGMA_UB 5
// std::mt19937 gen(3);
// gen

std::default_random_engine gen;

// class Results{
//     public:
//     T mean;
//     T sigma;
//     T elbo;

//     Results(T mean, T sigma, T elbo){
//         this->mean = mean;
//         this->sigma = sigma;
//         this->elbo = elbo;
//     }
// };


template< typename Obs_ty, typename prior_T, typename guide_T, typename mu_learn_ty, typename std_learn_ty >
auto Infer(Obs_ty &N, prior_T& T_prior, guide_T& T_var,mu_learn_ty& mu_var, std_learn_ty& sigma_var, T learning_rate, int  NUM_SAMPLES, int NUM_ITERS = 1000)
{
    T diff_elbo_mean = (T) 0;
    T diff_elbo_sigma = (T) 0;
    T second_term_diff_elbo = (T) 0;
    // T learning_rate = (T) 0.01;
    T LB = (T) -128;
    T UB = (T) 128;
    T final_grad_mean = (T) 0;
    T final_grad_sigma = (T) 0;
    T total_elbo = (T) 0;
    T SCALING = [PY:SCALING];

    //[ARD:REMOVE_BEGIN]
    // std::ofstream result_file(argv[1]);
    // result_file << "iter,elbo,mean,sigma,mu_ref,grad" << std::endl;
    // std::cout << "Num iters: " << NUM_ITERS << std::endl;
    // std::cout << "Learning rate: " << learning_rate << std::endl;
    // all_type_info<T>();
    //[ARD:REMOVE_END]
    T max_elbo = std::numeric_limits<T>::lowest();
    T max_mean = (T) 0;
    T max_sigma = (T) 0;
    Results max_results(max_mean, max_sigma, max_elbo);

    for(int c_iter = 0;c_iter < NUM_ITERS; c_iter++)
    {
        diff_elbo_mean =0;
        diff_elbo_sigma =0;
        total_elbo =0;
        for(int c_sample = 0; c_sample < NUM_SAMPLES; c_sample++)
        {
            T_prior(T_var.sample()); // Add sampling contraints if it doesnt work

            second_term_diff_elbo = N.log_pdf().value()/SCALING + T_prior.log_pdf().value()/SCALING - T_var.log_pdf().value()/SCALING;
            diff_elbo_mean += T_var.diff_log(T_var.mu)*(second_term_diff_elbo);
            diff_elbo_sigma += T_var.diff_log(T_var.stddev)*(second_term_diff_elbo);
            total_elbo += second_term_diff_elbo;
        }
        final_grad_mean = grad_clipping<T>(diff_elbo_mean/NUM_SAMPLES, LB, UB);
        final_grad_sigma = grad_clipping<T>(diff_elbo_sigma/NUM_SAMPLES, LB, UB);
        
        if(total_elbo > max_elbo)
        {
            max_results.mean = mu_var.value();
            max_results.sigma = sigma_var.value();
            max_results.elbo = total_elbo;
        }

        //[ARD:REMOVE_BEGIN]
        // result_file << c_iter << "," << total_elbo/NUM_SAMPLES << "," << mu_var.value() << "," << sigma_var.value() << ",95"<<", "<< final_grad_mean<< std::endl;
        //[ARD:REMOVE_END]
        mu_var(mu_var.value() + learning_rate*final_grad_mean);
        sigma_var(grad_clipping<T>(sigma_var.value() + learning_rate*final_grad_sigma, SIGMA_LB, SIGMA_UB));
        // std::cout << "Iteration: " << c_iter<< "--- mu: " << mu_var.value() << ", sigma: " << sigma_var.value() << std::endl;
    }

    return max_results;
}

template < typename Tc = T, typename std::enable_if<std::is_base_of<fpm::fixedpoint_base, Tc>::value>::type* = nullptr> inline
Tc sample(Tc& mu_value, Tc& stddev_value)
{
    auto sign_and_int_bits = Tc::integer_bits;

    uint32_t random32_1 = gen();
    random32_1 = random32_1 << sign_and_int_bits;
    random32_1 = random32_1 >> sign_and_int_bits;

    uint32_t random32_2 = gen();
    random32_2 = random32_2 << sign_and_int_bits;
    random32_2 = random32_2 >> sign_and_int_bits;

    uint32_t random32_3 = gen();
    random32_3 = random32_3 << sign_and_int_bits;
    random32_3 = random32_3 >> sign_and_int_bits;

    auto sum = random32_1 + random32_2 + random32_3 ;
    sum = sum << 1;

    auto shifted_mean = Tc::from_raw_value(sum) - Tc(3);
    return (shifted_mean *stddev_value) + mu_value;
}


template <typename Tc = T, typename std::enable_if<std::is_arithmetic<Tc>::value>::type* = nullptr> inline
Tc sample(Tc& mu_value, Tc& stddev_value)
{
    std::normal_distribution<Tc> dist(mu_value, stddev_value);
    return dist(gen);
}


template<int N>
void gen_data(std::array<T,N> &xtrue, std::array<T, N> &yobs)
{
    T init_x0 = 0;
    T init_sigma = 2500;
    T x0 = sample(init_x0, init_sigma); // this decides the "starting point" of the data
    T noise = 1;
    for(int i = 0; i < N; i++)
    {
        xtrue[i] = sample(x0, noise);
        yobs[i] = sample(xtrue[i], noise);
    }
}

//[ARD:REMOVE_BEGIN]
template <int N>
void print_data(std::array<T, N> &xtrue, std::array<T, N> &yobs)
{
    for(int i = 0; i < N; i++)
    {
        std::cout << xtrue[i] << "," << yobs[i] << std::endl;
    }
}
//[ARD:REMOVE_END]

//[ARD:REMOVE_BEGIN]
#include <chrono>
//[ARD:REMOVE_END]

int main(int argc, char ** argv)//[ARD:SETUP_DEF]
{
    //[ARD:SERIAL_MONITOR]

    const int NUM_DATA_POINTS = 500;
    // std::array<float, NUM_DATA_POINTS> true_positions{287.081, 287.608, 287.939, 288.961, 288.637, 288.043, 288.6, 287.818, 289.386, 288.673, 289.59, 289.806, 290.304,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 300.46, 300.904};
    
    std::array<float, NUM_DATA_POINTS> true_positions {29.4646, 29.4982, 31.6229, 31.4951, 30.5592, 28.5439, 28.3593, 28.7362, 28.4009, 28.1158, 27.6449, 27.2393, 26.2511,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 20.7654, 20.8879};
    std::array<float, NUM_DATA_POINTS> yobs_positions {29.4979, 29.9608, 32.6439, 30.8079, 29.7865, 27.6493, 28.2855, 30.1385, 29.6125, 26.8016, 29.3181, 26.6323, 27.3558,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 21.5086, 21.3913};
    
    // add 10 to true_positions
    for(int i = 0; i < NUM_DATA_POINTS; i++)
    {
        true_positions[i] += 70;
    }

    // add 10 to yobs_positions
    for(int i = 0; i < NUM_DATA_POINTS; i++)
    {
        yobs_positions[i] += 70;
    }

    // std::array<T, NUM_DATA_POINTS> yobs_positions{286.604, 287.156, 288.433, 288.594, 289.706, 287.998, 288.407, 288.365, 290.628, 288.488, 288.775, 288.885, 291.16,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 301.769, 299.94};
    
    const int num_experiments = [PY:NUM_EXPERIMENTS];
    // std::array<float, num_experiments> position_infer;
    std::array<float, num_experiments> rmse_all_exp;
    std::array<float, num_experiments> geomean_all_exp;

    //[ARD:REMOVE_BEGIN]
    std::cout << "rmse,geomean,num_iters,num_data_samples,num_obs_samples" << std::endl;
    //[ARD:REMOVE_END]


    //[ARD:UNCOMMENT_BEGIN]
    // Serial.println("rmse,geomean,num_iters,time_ms,num_data_samples,num_obs_samples");
    //[ARD:UNCOMMENT_END]

    for(int curr_exp = 0; curr_exp < num_experiments; curr_exp++)
    {

         //[ARD:UNCOMMENT_BEGIN]
         // randomSeed(analogRead(0));
        // unsigned long total_time = 0;
         // gen.seed(random(100));
         //[ARD:UNCOMMENT_END]

        //  [ARD:START_TIME]

        //[ARD:REMOVE_BEGIN]
        gen.seed(std::chrono::system_clock::now().time_since_epoch().count());
        //[ARD:REMOVE_END]
        
        // // Initialising the prior
        // T init_mu = 0;
        // T init_sigma = 250;
        // 20 original mu
        Constant<T> mu_T(90), sigma_T(5), data_T(0);
        auto T_prior = normal_dist<T>(mu_T, sigma_T,data_T);

        Constant<T> sigma_N(1), data_N(20);
        auto N = normal_dist<T>(T_prior, sigma_N,data_N);

        // Varaitional assignment of T (the posterior)
        Variable<T> mu_var(90), sigma_var(1);
        auto T_var = normal_dist<T>(mu_var, sigma_var, data_T);

        // // Learning
        int NUM_SAMPLES = [PY:NUM_SAMPLES];
        int NUM_ITERS = [PY:NUM_ITERS];
        // // auto results = Infer(N, T_prior, T_var, mu_var, sigma_var, 0.01, NUM_SAMPLES, NUM_ITERS);
        T learning_rate = (T)[PY:LEARNING_RATE];
        std::array<T, NUM_DATA_POINTS> predicted_positions;

        //[ARD:START_TIME]
        for(int i = 0; i < yobs_positions.size(); i++)
        {
            data_N(yobs_positions[i]);
            // mu_T(mu_T.value() + time_step*velocity_control_with_noise[i]);
            auto results = Infer(N, T_prior, T_var, mu_var, sigma_var,learning_rate, NUM_SAMPLES, NUM_ITERS);

            // std::cout << "ELBO: " << results.elbo << std::endl;
            // std::cout << "Mean: " << results.mean << std::endl;
            // std::cout << "Sigma: " << results.sigma << std::endl;

            mu_T(results.mean);
            sigma_T(1);
            predicted_positions[i] =  results.mean;
            // sigma_T(results.sigma);
            // data_N(25);
            mu_var(results.mean);
            // sigma_var(results.sigma);
        }
        //[ARD:END_TIME]


        //[ARD:UNCOMMENT_BEGIN]
        // total_time+=curr_total_time;
        // Serial.println("Average Total time: " + String((float)total_time/num_experiments));
        //[ARD:UNCOMMENT_END]


        // convert predicted position to float
        std::array<float, NUM_DATA_POINTS> predicted_positions_float;
        for(int i = 0; i < predicted_positions.size(); i++)
        {
            predicted_positions_float[i] = (float)predicted_positions[i];
        }
        

        float rmse_i = rmse(true_positions, predicted_positions_float,[PY:BURN_IN]);
        float geomean_i = geomean(true_positions, predicted_positions_float,[PY:BURN_IN]);
        rmse_all_exp[curr_exp] = rmse_i;
        geomean_all_exp[curr_exp] = geomean_i;

        // print predicted positions float
        // std::cout << "timestep,true_position,predicted_position,relative_error" << std::endl;

        // for(int i = 0; i < true_positions.size(); i++)
        // {
        //     std::cout << i << "," << true_positions[i] << "," << predicted_positions_float[i] << ",      "<< std::abs(predicted_positions_float[i] - true_positions[i])/true_positions[i] << std::endl;
        // }
        

        

        //[ARD:REMOVE_BEGIN]
        std::cout <<rmse_i << "," << geomean_i << "," << NUM_ITERS << "," << NUM_SAMPLES << "," << NUM_DATA_POINTS << std::endl;
        //[ARD:REMOVE_END]

        break;

        //[ARD:UNCOMMENT_BEGIN]
        // Serial.println(String(float(rmse_i),4) + "," + String(float(geomean_i),4) + "," + String(NUM_ITERS) + ","+String(curr_total_time)+","+String(NUM_SAMPLES) + "," + String(NUM_DATA_POINTS));
        //[ARD:UNCOMMENT_END]
    }

}

//[ARD:ADD_LOOP]